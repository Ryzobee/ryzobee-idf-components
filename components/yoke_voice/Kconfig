## components/yoke_voice/Kconfig
```kconfig
menu "Yoke Voice"
config YOKE_VOICE_RUNTIME
    bool "GMF runtime support"
    default y
config YOKE_VOICE_PLAYER
    bool "Convenient asynchronous player"
    depends on YOKE_VOICE_RUNTIME
    default y
config YOKE_VOICE_HTTP
    bool "HTTP IO support"
    depends on YOKE_VOICE_RUNTIME
    default y
config YOKE_VOICE_NETWORK_HELPER
    bool "Optional default Wi-Fi STA and SNTP helper"
    depends on YOKE_VOICE_HTTP
    default y
endmenu
```

## components/yoke_voice/examples/gmf_play_file/main/Kconfig.projbuild
```kconfig
menu "GMF Audio Examples"
    config ROOTMAKER_HTTP_URL
        string "HTTP/HTTPS MP3 URL"
        default "https://dl.espressif.com/dl/audio/gs-16b-2c-44100hz.mp3"
    config ROOTMAKER_MUXER_SLICE_MS
        int "Muxer recording slice duration (ms)"
        range 1000 60000
        default 60000
        help
            WAV file segmentation duration. Set 5000 to split a 10-second recording.
endmenu
```

## components/yoke_voice/examples/gmf_play_http/main/Kconfig.projbuild
```kconfig
menu "GMF HTTP example"
config ROOTMAKER_HTTP_URL
    string "HTTP/HTTPS MP3 URL"
    default "https://dl.espressif.com/dl/audio/gs-16b-2c-44100hz.mp3"
endmenu
```

## components/yoke_voice/examples/player_demo/sdkconfig.defaults
```kconfig
# Board: ESP32-S3, 16 MB flash, quad PSRAM.
# 保持原固件的 Newlib 行为，避免 IDF 6 默认切换到 Picolibc。
CONFIG_LIBC_NEWLIB=y
# 保持已提交 sdkconfig 的诊断策略；上游空 codec 注册表会产生 type-limits 警告。
CONFIG_COMPILER_DISABLE_DEFAULT_ERRORS=y
CONFIG_IDF_TARGET="esp32s3"
CONFIG_ESPTOOLPY_FLASHSIZE_16MB=y
CONFIG_ESPTOOLPY_FLASHMODE_QIO=y
CONFIG_ESPTOOLPY_FLASHFREQ_80M=y
CONFIG_FREERTOS_HZ=1000
# Receive microphone UART data while LittleFS disables the Flash cache.
CONFIG_UART_ISR_IN_IRAM=y
CONFIG_PARTITION_TABLE_CUSTOM=y
CONFIG_PARTITION_TABLE_CUSTOM_FILENAME="partitions.csv"
CONFIG_SPIRAM=y
CONFIG_SPIRAM_MODE_QUAD=y
CONFIG_SPIRAM_SPEED_80M=y
# CONFIG_SPIRAM_MEMTEST is not set
CONFIG_SPIRAM_ALLOW_STACK_EXTERNAL_MEMORY=y
CONFIG_ESP_DEFAULT_CPU_FREQ_MHZ_240=y
CONFIG_ESP_CONSOLE_UART_DEFAULT=y
CONFIG_ESP_CONSOLE_SECONDARY_NONE=y

# Audio player: MP3/WAV playback and framed raw Opus recording.
# CONFIG_AUDIO_DECODER_AAC_SUPPORT is not set
CONFIG_AUDIO_DECODER_MP3_SUPPORT=y
# CONFIG_AUDIO_DECODER_G711_SUPPORT is not set
# CONFIG_AUDIO_DECODER_AMRNB_SUPPORT is not set
# CONFIG_AUDIO_DECODER_AMRWB_SUPPORT is not set
# CONFIG_AUDIO_DECODER_FLAC_SUPPORT is not set
CONFIG_AUDIO_DECODER_OPUS_SUPPORT=y
# CONFIG_AUDIO_DECODER_VORBIS_SUPPORT is not set
# CONFIG_AUDIO_DECODER_ADPCM_SUPPORT is not set
# CONFIG_AUDIO_DECODER_ALAC_SUPPORT is not set
CONFIG_AUDIO_DECODER_PCM_SUPPORT=y
# CONFIG_AUDIO_DECODER_SBC_SUPPORT is not set
# CONFIG_AUDIO_DECODER_LC3_SUPPORT is not set
# CONFIG_AUDIO_DECODER_G722_SUPPORT is not set
CONFIG_AUDIO_SIMPLE_DEC_WAV_SUPPORT=y
# CONFIG_AUDIO_SIMPLE_DEC_M4A_SUPPORT is not set
# CONFIG_AUDIO_SIMPLE_DEC_TS_SUPPORT is not set
# CONFIG_AUDIO_SIMPLE_DEC_OGG_SUPPORT is not set
# CONFIG_AUDIO_ENCODER_AAC_SUPPORT is not set
# CONFIG_AUDIO_ENCODER_G711_SUPPORT is not set
# CONFIG_AUDIO_ENCODER_AMRNB_SUPPORT is not set
# CONFIG_AUDIO_ENCODER_AMRWB_SUPPORT is not set
# CONFIG_AUDIO_ENCODER_OPUS_SUPPORT is not set
# CONFIG_AUDIO_ENCODER_ADPCM_SUPPORT is not set
# CONFIG_AUDIO_ENCODER_ALAC_SUPPORT is not set
# CONFIG_AUDIO_ENCODER_SBC_SUPPORT is not set
# CONFIG_AUDIO_ENCODER_LC3_SUPPORT is not set
# CONFIG_AUDIO_ENCODER_G722_SUPPORT is not set

# CI1302 UART playback does not use external codec chips or muxers.
# CONFIG_CODEC_ES8311_SUPPORT is not set
# CONFIG_CODEC_ES7210_SUPPORT is not set
# CONFIG_CODEC_ES7243_SUPPORT is not set
# CONFIG_CODEC_ES7243E_SUPPORT is not set
# CONFIG_CODEC_ES8156_SUPPORT is not set
# CONFIG_CODEC_AW88298_SUPPORT is not set
# CONFIG_CODEC_ES8389_SUPPORT is not set
# CONFIG_CODEC_ES8374_SUPPORT is not set
# CONFIG_CODEC_ES8388_SUPPORT is not set
# CONFIG_CODEC_TAS5805M_SUPPORT is not set
# CONFIG_CODEC_ZL38063_SUPPORT is not set
# CONFIG_CODEC_CJC8910_SUPPORT is not set
# CONFIG_CODEC_DUMMY_SUPPORT is not set
# CONFIG_CODEC_DATA_ADC_SUPPORT is not set
# CONFIG_ESP_MUXER_MP4_SUPPORT is not set
# CONFIG_ESP_MUXER_TS_SUPPORT is not set
# CONFIG_ESP_MUXER_OGG_SUPPORT is not set
# CONFIG_ESP_MUXER_FLV_SUPPORT is not set
# CONFIG_ESP_MUXER_CAF_SUPPORT is not set
# CONFIG_ESP_MUXER_AVI_SUPPORT is not set

# GMF 1.1: Loader 负责原型注册，CI1302 使用自定义 IO。
# CONFIG_GMF_IO_INIT_CODEC_DEV_RX is not set
# CONFIG_GMF_IO_INIT_CODEC_DEV_TX is not set
CONFIG_GMF_IO_INIT_FILE_READER=y
# CONFIG_GMF_IO_INIT_FILE_WRITER is not set
# CONFIG_GMF_IO_INIT_HTTP_READER is not set
# CONFIG_GMF_IO_INIT_HTTP_WRITER is not set
CONFIG_GMF_IO_INIT_FLASH_READER=y
CONFIG_GMF_IO_FILE_READER_TASK_STACK=0
CONFIG_GMF_IO_FILE_READ_CACHE_SIZE=0
CONFIG_GMF_AUDIO_CODEC_INIT_DECODER=y
CONFIG_GMF_AUDIO_CODEC_DECODER_TYPE_MP3=y
# CONFIG_GMF_AUDIO_EFFECT_INIT_ALC is not set
CONFIG_GMF_AUDIO_EFFECT_INIT_CH_CVT=y
CONFIG_GMF_AUDIO_EFFECT_CH_CVT_DEST_CH=1
CONFIG_GMF_AUDIO_EFFECT_INIT_BIT_CVT=y
CONFIG_GMF_AUDIO_EFFECT_BIT_CVT_DEST_BITS=16
CONFIG_GMF_AUDIO_EFFECT_INIT_RATE_CVT=y
CONFIG_GMF_AUDIO_EFFECT_RATE_CVT_DEST_RATE=16000
# CONFIG_GMF_AI_AUDIO_INIT_AEC is not set
# CONFIG_GMF_AI_AUDIO_INIT_WN is not set
# CONFIG_GMF_AI_AUDIO_INIT_AFE is not set
# CONFIG_GMF_AI_AUDIO_INIT_VAD is not set
# CONFIG_GMF_AI_AUDIO_INIT_NS is not set
# CONFIG_GMF_AI_AUDIO_INIT_DOA is not set
# CONFIG_GMF_AI_AUDIO_LOAD_CH_ALLOCATION_FROM_BOARD is not set
# CONFIG_GMF_VIDEO_CODEC_INIT_ENCODER is not set
# CONFIG_GMF_VIDEO_CODEC_INIT_DECODER is not set
CONFIG_MBEDTLS_CERTIFICATE_BUNDLE=y
# CONFIG_ESP_TLS_INSECURE is not set
CONFIG_AUDIO_ENCODER_PCM_SUPPORT=y
CONFIG_GMF_AUDIO_CODEC_INIT_ENCODER=y
CONFIG_GMF_AUDIO_CODEC_ENCODER_TYPE_PCM=y
CONFIG_GMF_AUDIO_MUXER_INIT=y
CONFIG_ESP_MUXER_WAV_SUPPORT=y
CONFIG_GMF_AUDIO_MUXER_DEFAULT_TYPE_WAV=y
CONFIG_GMF_AUDIO_MUXER_AUDIO_CODEC_PCM=y
CONFIG_GMF_AUDIO_MUXER_OUTPUT_TYPE_FILE=y

CONFIG_YOKE_VOICE_RUNTIME=y
```

## components/yoke_voice/tests/target/io_only/sdkconfig.defaults
```kconfig
CONFIG_IDF_TARGET="esp32s3"
CONFIG_LIBC_NEWLIB=y
CONFIG_UART_ISR_IN_IRAM=y
# CONFIG_YOKE_VOICE_RUNTIME is not set
# CONFIG_YOKE_VOICE_PLAYER is not set
# CONFIG_YOKE_VOICE_HTTP is not set
# CONFIG_YOKE_VOICE_NETWORK_HELPER is not set
```
